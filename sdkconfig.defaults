## sdkconfig.defaults
```kconfig
#
# ESP32 Energy Management System - Default Configuration
#

# Partition Table
CONFIG_PARTITION_TABLE_SINGLE_APP=y
CONFIG_PARTITION_TABLE_SINGLE_APP_LARGE=n

# Serial flasher config
CONFIG_ESPTOOLPY_FLASHSIZE_4MB=y
CONFIG_ESPTOOLPY_FLASHMODE_DIO=y
CONFIG_ESPTOOLPY_FLASHFREQ_40M=y

# Compiler options
CONFIG_COMPILER_OPTIMIZATION_SIZE=n
CONFIG_COMPILER_OPTIMIZATION_DEFAULT=y
CONFIG_COMPILER_OPTIMIZATION_ASSERTIONS_ENABLE=y
CONFIG_COMPILER_STACK_CHECK_MODE_NORM=y

# Component config

# ESP32-specific
CONFIG_ESP32_DEFAULT_CPU_FREQ_240=y
CONFIG_ESP32_SPIRAM_SUPPORT=n

# FreeRTOS
CONFIG_FREERTOS_UNICORE=n
CONFIG_FREERTOS_HZ=1000
CONFIG_FREERTOS_TASK_FUNCTION_WRAPPER=y
CONFIG_FREERTOS_CHECK_STACKOVERFLOW_CANARY=y

# Log output
CONFIG_LOG_DEFAULT_LEVEL_INFO=y
CONFIG_LOG_DEFAULT_LEVEL=3
CONFIG_LOG_MAXIMUM_EQUALS_DEFAULT=y

# LWIP (TCP/IP Stack)
CONFIG_LWIP_SO_RCVTIMEO=y
CONFIG_LWIP_SO_SNDTIMEO=y
CONFIG_LWIP_TCP_KEEPALIVE_DEFAULT=y
CONFIG_LWIP_TCP_KEEP_CONNECTION_WHEN_IP_CHANGES=y

# TCP
CONFIG_LWIP_TCP_SYNMAXRTX=6
CONFIG_LWIP_TCP_SND_BUF_DEFAULT=5760
CONFIG_LWIP_TCP_WND_DEFAULT=5760
CONFIG_LWIP_TCP_RECVMBOX_SIZE=6
CONFIG_LWIP_UDP_RECVMBOX_SIZE=6
CONFIG_LWIP_TCPIP_RECVMBOX_SIZE=32

# Wi-Fi
CONFIG_ESP32_WIFI_SW_COEXIST_ENABLE=y
CONFIG_ESP32_WIFI_STATIC_RX_BUFFER_NUM=10
CONFIG_ESP32_WIFI_DYNAMIC_RX_BUFFER_NUM=32
CONFIG_ESP32_WIFI_TX_BUFFER=32
CONFIG_ESP32_WIFI_RX_BA_WIN=6
CONFIG_ESP32_WIFI_TX_BA_WIN=6
CONFIG_ESP32_WIFI_AMPDU_RX_ENABLED=y
CONFIG_ESP32_WIFI_AMPDU_TX_ENABLED=y
CONFIG_ESP32_WIFI_NVS_ENABLED=y

# mbedTLS
CONFIG_MBEDTLS_INTERNAL_MEM_ALLOC=y
CONFIG_MBEDTLS_SSL_MAX_CONTENT_LEN=16384

# NVS
CONFIG_NVS_ENCRYPTION=n

# SPI Flash driver
CONFIG_SPI_FLASH_WRITING_DANGEROUS_REGIONS_ABORTS=n

# Task WDT
CONFIG_ESP_TASK_WDT=y
CONFIG_ESP_TASK_WDT_PANIC=y
CONFIG_ESP_TASK_WDT_TIMEOUT_S=5
CONFIG_ESP_TASK_WDT_CHECK_IDLE_TASK_CPU0=y
CONFIG_ESP_TASK_WDT_CHECK_IDLE_TASK_CPU1=y

# Interrupt WDT
CONFIG_ESP_INT_WDT=y
CONFIG_ESP_INT_WDT_TIMEOUT_MS=300
CONFIG_ESP_INT_WDT_CHECK_CPU0=y
CONFIG_ESP_INT_WDT_CHECK_CPU1=y

# Memory protection
CONFIG_ESP_SYSTEM_PANIC_PRINT_HALT=y

# Power Management
CONFIG_PM_ENABLE=n

# Application Trace
CONFIG_APPTRACE_ENABLE=n

# Energy Manager Specific Configuration
CONFIG_ENERGY_MANAGER_TASK_STACK_SIZE=4096
CONFIG_ENERGY_MANAGER_MODBUS_TIMEOUT_MS=5000
CONFIG_ENERGY_MANAGER_WIFI_RETRY_COUNT=5

# Development/Debug options
CONFIG_ENERGY_DEBUG_ENABLED=n
CONFIG_ENERGY_OPTIMIZE_SIZE=n
```
